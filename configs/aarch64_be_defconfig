## configs/aarch64_be_defconfig
```kconfig
# AArch64 Big Endian configuration
BR2_aarch64_be=y
BR2_AARCH64_PAGE_SIZE_4K=y
BR2_TOOLCHAIN_BUILDROOT_MUSL=y
BR2_TOOLCHAIN_BUILDROOT_CXX=y
BR2_KERNEL_HEADERS_5_15=y
BR2_BINUTILS_VERSION_2_39_X=y
BR2_GCC_VERSION_12_X=y
BR2_TOOLCHAIN_BUILDROOT_FORTRAN=y
BR2_GCC_ENABLE_LTO=y
BR2_STATIC_LIBS=y
BR2_OPTIMIZE_2=y
BR2_SSP_REGULAR=y
BR2_RELRO_PARTIAL=y
```

## configs/arm32v7le_defconfig
```kconfig
# ARM32v7 Little Endian configuration
BR2_arm=y
BR2_cortex_a8=y
BR2_ARM_EABI=y
BR2_ARM_INSTRUCTIONS_THUMB2=y
BR2_TOOLCHAIN_BUILDROOT_MUSL=y
BR2_TOOLCHAIN_BUILDROOT_CXX=y
BR2_KERNEL_HEADERS_5_15=y
BR2_BINUTILS_VERSION_2_39_X=y
BR2_GCC_VERSION_12_X=y
BR2_TOOLCHAIN_BUILDROOT_FORTRAN=y
BR2_GCC_ENABLE_LTO=y
BR2_STATIC_LIBS=y
BR2_OPTIMIZE_2=y
BR2_SSP_REGULAR=y
BR2_RELRO_PARTIAL=y
```

## configs/mips32v2le_defconfig
```kconfig
# MIPS32v2 Little Endian configuration
BR2_mips=y
BR2_mips_32r2=y
BR2_MIPS_SOFT_FLOAT=y
BR2_TOOLCHAIN_BUILDROOT_MUSL=y
BR2_TOOLCHAIN_BUILDROOT_CXX=y
BR2_KERNEL_HEADERS_5_15=y
BR2_BINUTILS_VERSION_2_39_X=y
BR2_GCC_VERSION_12_X=y
BR2_TOOLCHAIN_BUILDROOT_FORTRAN=y
BR2_GCC_ENABLE_LTO=y
BR2_STATIC_LIBS=y
BR2_OPTIMIZE_2=y
BR2_SSP_REGULAR=y
BR2_RELRO_PARTIAL=y
```

## configs/sh432be_defconfig
```kconfig
# SuperH 4 32-bit Big Endian configuration
BR2_sh=y
BR2_sh4eb=y
BR2_ENDIAN_BIG=y
BR2_TOOLCHAIN_BUILDROOT_MUSL=y
BR2_TOOLCHAIN_BUILDROOT_CXX=y
BR2_KERNEL_HEADERS_5_15=y
BR2_BINUTILS_VERSION_2_39_X=y
BR2_GCC_VERSION_12_X=y
BR2_TOOLCHAIN_BUILDROOT_FORTRAN=y
BR2_GCC_ENABLE_LTO=y
BR2_STATIC_LIBS=y
BR2_OPTIMIZE_2=y
BR2_SSP_REGULAR=y
BR2_RELRO_PARTIAL=y
```
